## Firmware/main/Kconfig.projbuild
```kconfig
menu "IoT Gateway Interface"

	choice IOT_INTERFACE
        prompt "Select the target interface"
        default IOT_INTERFACE_AIO
        help
            Select the adopted IoT wireless interface.
        config IOT_INTERFACE_AIO
            bool "Analog"
            help
                Input/Output support for Analog Sensors:
				    0(2)-10 V
				    0(4)-20 mA
        config IOT_INTERFACE_DIO
            bool "Digital"
            help
                Interface support for Digital Sensors:
				    RS485
				Protocols
				    Modbus
                    BACnet
        config IOT_INTERFACE_TMP
            bool "Temperature"
            help
                Support for RTD elemnts
                2/3/4-wires passive
    endchoice
	
	if IOT_INTERFACE_AIO
		menu "Analog Configuration"
			
		endmenu
	endif
	
	if IOT_INTERFACE_DIO
		menu "Digital Configuration"
            menu "UART-Config"

                config MB_UART_PORT_NUM
                    int "UART port number"
                    range 0 2
                    default 2
                    help
                        UART communication port number for Modbus example.
            
                config MB_UART_BAUD_RATE
                    int "UART communication speed"
                    range 1200 115200
                    default 38400
                    help
                        UART communication speed for Modbus example.
            
                config MB_UART_RXD
                    int "UART RXD pin number"
                    range 0 34
                    default 16
                    help
                        GPIO number for UART RX pin. See UART documentation for more information
                        about available pin numbers for UART.
            
                config MB_UART_TXD
                    int "UART TXD pin number"
                    range 0 34
                    default 17
                    help
                        GPIO number for UART TX pin. See UART documentation for more information
                        about available pin numbers for UART.
            
                config MB_UART_RTS
                    int "UART RTS pin number"
                    range 0 34
                    default 18
                    help
                        GPIO number for UART RTS pin. This pin is connected to
                        ~RE/DE pin of RS485 transceiver to switch direction.
                        Not neccessary for automatic switching board. 
            
                choice MB_COMM_MODE
                    prompt "Modbus communication mode"
                    default MB_COMM_MODE_RTU if CONFIG_FMB_COMM_MODE_RTU_EN
                    help
                        Selection of Modbus communication mode option for Modbus.
            
                    config MB_COMM_MODE_RTU
                        bool "RTU mode"
                        depends on FMB_COMM_MODE_RTU_EN
            
                    config MB_COMM_MODE_ASCII
                        bool "ASCII mode"
                        depends on FMB_COMM_MODE_ASCII_EN
            
                endchoice
            
            endmenu

        endmenu
    endif   
        
    if IOT_INTERFACE_TMP
		menu "Temperature Configuration"
			
        endmenu
        
    endif
    
    menu "Optional Config"

        config testmode
            bool "Testmode"
            help 
                Aktivate Testmode. Testing
                    LED
                    WiFi
                    Option to enable lagacy mode

            config LED_GPIO
                int "LED PIN"
                default 2
                range 0 37
                help
                    Select PIN which is connected to debug LED. 
        
        if testmode
 

            config legacy_mode
                bool "Lagacy"
                help
                    Activate old Modules from AIO software 
                               
                    

        endif            
        choice NETWORK_INTERFACE
            prompt "Select the network interface"
            default NETWORK_WIFI
            help
                Select the adopted IoT wireless interface.
            config NETWORK_WIFI
                bool "Wi-Fi (IEEE-802.11 B/G/N)"
                help
                    Use Wi-Fi communication (WPA/WPA2).
            config NETWORK_PPP
                bool "LTE (CAT-M1/NB1)"
                help
                    Use LTE M2M or NB-IoT communication.
        endchoice


    endmenu




	
	if NETWORK_WIFI
		menu "WiFi Configuration"
			
		endmenu
	endif
	
	if NETWORK_PPP
		menu "LTE (CAT-M1) Configuration"
			
            menu "UART - LTE"
                menu "Adapter"
                    config UART_MODEM_PORT
                        int "Port Number"
                        default 1
                        range 0 2
                        help
                            Serial Port Number.
        
                    config UART_MODEM_BAUDRATE
                        int "Baudrate"
                        default 921600
                        range 9600 921600
                        help
                            Serial Baudrate.
        
                    config UART_TX_BUFFER_SIZE
                        int "UART TX Buffer Size"
                        range 256 2048
                        default 512
                        help
                            Buffer size of UART TX buffer.
                    
                    config UART_RX_BUFFER_SIZE
                        int "UART RX Buffer Size"
                        range 256 2048
                        default 1024
                        help
                            Buffer size of UART RX buffer.
                endmenu
        
                menu "Physical"
                    config UART_MODEM_TX_PIN
                        int "TXD Pin Number"
                        default 33
                        range 0 40
                        help
                            Pin number of UART TX.
            
                    config UART_MODEM_RX_PIN
                        int "RXD Pin Number"
                        default 34
                        range 0 40
                        help
                            Pin number of UART RX.
            
                    config UART_MODEM_RTS_PIN
                        int "RTS Pin Number"
                        default 32
                        range 0 40
                        help
                            Pin number of UART RTS.
            
                    config UART_MODEM_CTS_PIN
                        int "CTS Pin Number"
                        default 35
                        range 0 40
                        help
                            Pin number of UART CTS.
                endmenu
        
                menu "Stack"
                    config UART_EVENT_TASK_STACK_SIZE
                        int "UART Event Task Stack Size"
                        range 2000 6000
                        default 2048
                        help
                            Stack size of UART event task.
            
                    config UART_EVENT_TASK_PRIORITY
                        int "UART Event Task Priority"
                        range 3 22
                        default 5
                        help
                            Priority of UART event task.
            
                    config UART_EVENT_QUEUE_SIZE
                        int "UART Event Queue Size"
                        range 10 40
                        default 30
                        help
                            Length of UART event queue.
            
                    config UART_PATTERN_QUEUE_SIZE
                        int "UART Pattern Queue Size"
                        range 10 40
                        default 20
                        help
                            Length of UART pattern queue.
                endmenu
            endmenu

            menu "ISP Configuration"
            
		        config ISP_NOC
                    string "Set Network Operator Code (NOC)"
                    default "26201"
                    help
                        GSM Location Area Identification number (3-digit country code + 2-digit network code).
                    
                config ISP_APN
                    string "Set Access Point Name (APN)"
                    default "internet.nbiot.telekom.de"
                    help
                        Logical name which is used to select the GGSN or the external packet data network.
                    
                config ISP_PPP_AUTH_USERNAME
                    string "Set username for authentication"
                    default ""
                    help
                        Set username for PPP Authentication.
                    
                config ISP_PPP_AUTH_PASSWORD
                    string "Set password for authentication"
                    default ""
                    help
                        Set password for PPP Authentication.
            endmenu
        endmenu
    endif

	
    

endmenu
```

## Firmware/sdkconfig.defaults
```kconfig
#
# Partition Table
#
CONFIG_PARTITION_TABLE_CUSTOM=y
CONFIG_PARTITION_TABLE_CUSTOM_FILENAME="partitions.csv"
CONFIG_PARTITION_TABLE_FILENAME="partitions.csv"
CONFIG_PARTITION_TABLE_OFFSET=0x8000
CONFIG_PARTITION_TABLE_MD5=y

CONFIG_ESPTOOLPY_FLASHSIZE_16MB=y
CONFIG_ESPTOOLPY_FLASHSIZE="16MB"

# Override some defaults to enable PPP
CONFIG_LWIP_PPP_SUPPORT=y
CONFIG_LWIP_PPP_NOTIFY_PHASE_SUPPORT=y
CONFIG_LWIP_PPP_PAP_SUPPORT=y
CONFIG_LWIP_TCPIP_TASK_STACK_SIZE=4096

# Override for setting up from pc (Access to webserver)
CONFIG_HTTPD_MAX_REQ_HDR_LEN=1024
CONFIG_HTTPD_MAX_URI_LEN=1024

#Override some defaults to enable Modbus
CONFIG_MB_COMM_MODE_RTU=y
CONFIG_MB_UART_BAUD_RATE=38400
CONFIG_FMB_TIMER_PORT_ENABLED=y
CONFIG_FMB_TIMER_GROUP=1
CONFIG_FMB_TIMER_INDEX=0
CONFIG_FMB_TIMER_ISR_IN_IRAM=y
CONFIG_FMB_MASTER_DELAY_MS_CONVERT=200
CONFIG_FMB_MASTER_TIMEOUT_MS_RESPOND=150

#
# Bluetooth
#
CONFIG_BT_ENABLED=y
CONFIG_BTDM_CTRL_MODE_BLE_ONLY=y
CONFIG_BTDM_CTRL_BLE_MAX_CONN=3
CONFIG_BTDM_CTRL_BR_EDR_SCO_DATA_PATH_EFF=0
CONFIG_BTDM_CTRL_BLE_MAX_CONN_EFF=3
CONFIG_BTDM_CTRL_BR_EDR_MAX_ACL_CONN_EFF=0
CONFIG_BTDM_CTRL_BR_EDR_MAX_SYNC_CONN_EFF=0
CONFIG_BTDM_CTRL_PINNED_TO_CORE_0=y
CONFIG_BTDM_CTRL_PINNED_TO_CORE=0
CONFIG_BTDM_CTRL_HCI_MODE_VHCI=y
CONFIG_BT_NIMBLE_ENABLED=y

#
# NimBLE Options
#
CONFIG_BT_NIMBLE_MEM_ALLOC_MODE_INTERNAL=y
CONFIG_BT_NIMBLE_MAX_CONNECTIONS=3
CONFIG_BT_NIMBLE_MAX_BONDS=3
CONFIG_BT_NIMBLE_MAX_CCCDS=8
CONFIG_BT_NIMBLE_L2CAP_COC_MAX_NUM=0
CONFIG_BT_NIMBLE_PINNED_TO_CORE_0=y
CONFIG_BT_NIMBLE_PINNED_TO_CORE=0
CONFIG_BT_NIMBLE_TASK_STACK_SIZE=4096
CONFIG_BT_NIMBLE_ROLE_CENTRAL=y
CONFIG_BT_NIMBLE_ROLE_PERIPHERAL=y
CONFIG_BT_NIMBLE_ROLE_BROADCASTER=y
CONFIG_BT_NIMBLE_ROLE_OBSERVER=y
CONFIG_BT_NIMBLE_NVS_PERSIST=y
CONFIG_BT_NIMBLE_SM_LEGACY=y
CONFIG_BT_NIMBLE_SM_SC=y
CONFIG_BT_NIMBLE_SVC_GAP_DEVICE_NAME="nimble"
CONFIG_BT_NIMBLE_GAP_DEVICE_NAME_MAX_LEN=31
CONFIG_BT_NIMBLE_ATT_PREFERRED_MTU=256
CONFIG_BT_NIMBLE_SVC_GAP_APPEARANCE=0
CONFIG_BT_NIMBLE_ACL_BUF_COUNT=12
CONFIG_BT_NIMBLE_ACL_BUF_SIZE=255
CONFIG_BT_NIMBLE_HCI_EVT_BUF_SIZE=70
CONFIG_BT_NIMBLE_HCI_EVT_HI_BUF_COUNT=30
CONFIG_BT_NIMBLE_HCI_EVT_LO_BUF_COUNT=8
CONFIG_BT_NIMBLE_MSYS1_BLOCK_COUNT=12
CONFIG_BT_NIMBLE_HS_FLOW_CTRL=y
CONFIG_BT_NIMBLE_HS_FLOW_CTRL_ITVL=1000
CONFIG_BT_NIMBLE_HS_FLOW_CTRL_THRESH=2
CONFIG_BT_NIMBLE_HS_FLOW_CTRL_TX_ON_DISCONNECT=y
CONFIG_BT_NIMBLE_RPA_TIMEOUT=900
CONFIG_BT_NIMBLE_CRYPTO_STACK_MBEDTLS=y
```
